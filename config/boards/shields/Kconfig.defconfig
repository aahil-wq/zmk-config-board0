## config/boards/shields/Kconfig.defconfig
```kconfig
if SHIELD_MY_KEYBOARD_LEFT

# Name must be less than 16 characters long!
config ZMK_KEYBOARD_NAME
    default "board0"

config ZMK_SPLIT_ROLE_CENTRAL
    default y

endif

if SHIELD_BOARD0_LEFT || SHIELD_BOARD0_RIGHT

config ZMK_SPLIT
    default y

endif
```
